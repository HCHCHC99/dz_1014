#include "motor_adc.h"
#include "ring_buffer.h"
#include "main.h"

/******************************应用层变量定义*******************************/
// 电机采样句柄实例（原adc_adapter.c中的全局变量移到应用层）
ADC_CH_CTRL_t    hADCChannalMBV; // 母线电压采样
ADC_CH_CTRL_t    hADCChannalIVM; // 电流采样

// 采样缓冲区实例
uint16_t sample_buffer_vm[SAMPLE_BUFFER_SIZE_vm] = {0};
uint16_t sample_buffer_cur[SAMPLE_BUFFER_SIZE_cur] = {0};

// 电机测量状态变量（应用层内部维护）
static float s_motor_current = 0.0f;
static float s_motor_voltage = 0.0f;
static bool s_motor_measure_valid = false;  // 测量有效性标记
static bool s_motor_current_over = false;   // 过流标记
uint16_t    time_sample_current_over = 0;   // 过流计数

// 新增：记录电压最低值
volatile float s_motor_voltage_min = 999.9f;  // 初始化为一个较大的值

// 新增：欠压检测相关（使用计数器实现连续采样滤波）
#ifdef ENABLE_UNDER_VOLTAGE_PROTECTION
static uint16_t s_under_voltage_count = 0;    // 欠压连续计数
#endif

// ========== 电流校准相关变量 ==========
// 校准期间由 50us ISR 累加电流原始码，主循环到期取平均（不再轮询 ADC1）
static volatile bool s_calibration_running = false;
static bool s_calibration_done = false;
static float s_calibration_offset = 0.0f;
static volatile uint32_t s_calibration_sum = 0;
static volatile uint32_t s_calibration_count = 0;
static NonBlockingDelay_t s_calibration_delay;

extern RingBuffer current_buffer;
extern SystemContext g_sys_ctx;

/****************************** OC 模块（50us 过流采样，2026-08-22）*******************************/
/* 电流：200 点环形缓冲 + 窗口内超阈值点数（10ms 窗口，ISR 内整数维护） */
static uint16_t s_oc_ring[OC_WINDOW_SAMPLES];       /* 电流原始 ADC 码环形缓冲（200xuint16 = 400B） */
static int16_t s_oc_cur_ring_mA[OC_WINDOW_SAMPLES]; /* 电流值(mA)缓冲，与 s_oc_ring 同步推进；watch 里 ÷1000 = A */
static volatile int32_t s_oc_offset_mA = 0;          /* 校准偏移的定点表示(mA)，主循环算好，ISR 直接用 */
static uint16_t s_oc_head = 0;                      /* 环形缓冲写指针 */
static uint16_t s_oc_fill = 0;                      /* 已填充点数，达窗口长度后窗口就绪 */
static volatile uint32_t s_oc_ring_sum = 0;         /* 窗口内原始码之和（主循环算平均电流） */
static volatile uint16_t s_oc_above_count = 0;      /* 窗口内超阈值点数 */
static volatile bool s_oc_gate = false;             /* 1ms 门控（1ms ISR 置位，主循环消费） */
static bool s_oc_trip = false;                      /* 过流判定结果（门控节流后更新） */
static volatile bool s_oc_window_ready = false;     /* 窗口已填满一次 */
static uint16_t s_oc_thr_hi = 0;                    /* 上阈值 ADC 码 */
static uint16_t s_oc_thr_lo = 0;                    /* 下阈值 ADC 码 */
static uint32_t s_oc_tick = 0;                      /* 采样 tick 计数（电压采样节拍） */
static float s_oc_limit_last = 0.0f;                 /* 上次生效的电流限值（检测运行时改动） */

/* 电压：50us ISR 维护滑动平均（整数），主循环读均值 */
static uint16_t s_vm_ring[OC_VM_WINDOW_SAMPLES];    /* 电压原始码滑动缓冲 */
static uint16_t s_vm_head = 0;
static uint16_t s_vm_count = 0;
static volatile uint32_t s_vm_sum = 0;

/******************************应用层接口实现*******************************/
/**
 * @brief 电机ADC初始化（包含电流、电压通道）
 */
void ADC_Init_hz(void)
{
    ADC_CUR_Init();  // 初始化电流采样通道
    ADC_VM_Init();   // 初始化电压采样通道
}

/**
 * @brief 获取电机测量值
 * @param current 输出电流值
 * @param voltage 输出电压值
 * @param valid 测量有效性标志
 * @param current_over_valid 过流标志
 */
void MotorProtect_GetMeasure(float *current, float *voltage, bool *valid, bool *current_over_valid)
{
    if (current != NULL)
        *current = s_motor_current;
    if (voltage != NULL)
        *voltage = s_motor_voltage;
    if (valid != NULL)
        *valid = s_motor_measure_valid;
    if (current_over_valid != NULL)
        *current_over_valid = s_motor_current_over;
}

/****************************** OC 模块实现（50us 采样）*******************************/

/**
 * @brief ADC1 单通道转换（ISR 内调用，不经过 adc_adapter，避免线性查找与 1ms 节奏）
 * @param u8Channel 通道号（ADCH_IVM_ADCH / ADCH_VM_ADCH）
 * @return 12bit 原始码
 */
static uint16_t OC_Adc1_ConvertChannel(uint8_t u8Channel)
{
    stc_adc_ch_cfg_t stcChCfg;
    uint8_t u8SampTime = OC_ADC1_SAMPLE_TIME;
    uint16_t u16Data = 0u;

    MEM_ZERO_STRUCT(stcChCfg);
    stcChCfg.u32Channel  = (uint32_t)(0x1u << u8Channel);
    stcChCfg.u8Sequence  = ADC_SEQ_A;
    stcChCfg.pu8SampTime = &u8SampTime;
    ADC_AddAdcChannel(M4_ADC1, &stcChCfg);
    ADC_PollingSa(M4_ADC1, &u16Data, 1u, 10u);
    ADC_DelAdcChannel(M4_ADC1, &stcChCfg);
    return u16Data;
}

/**
 * @brief 电流采样入窗口（ISR 内调用，纯整数）
 */
/**
 * @brief 原始 ADC 码 -> 电流(mA) 定点换算（ISR 内调用，纯整数，不浮点）
 *        公式：mV = raw*3300/4096；I_mA = (mV-1650)*1000/66（未含校准偏移，偏移见 s_oc_offset_mA）
 */
static int32_t OC_RawToMa(uint16_t u16Raw)
{
    int32_t i32Mv = ((int32_t)u16Raw * 3300) / 4096;
    return ((i32Mv - 1650) * 1000) / 66;
}

static void OC_Accumulate(uint16_t u16Raw)
{
    uint16_t u16Old = s_oc_ring[s_oc_head];

    s_oc_ring[s_oc_head] = u16Raw;
    /* 同步写电流值(mA)缓冲，便于调试直接看电流（÷1000 = A） */
    s_oc_cur_ring_mA[s_oc_head] = (int16_t)(OC_RawToMa(u16Raw) + s_oc_offset_mA);
    s_oc_head++;
    if (s_oc_head >= OC_WINDOW_SAMPLES) {
        s_oc_head = 0;
    }
    s_oc_ring_sum += u16Raw;
    s_oc_ring_sum -= u16Old;

    if ((u16Raw > s_oc_thr_hi) || (u16Raw < s_oc_thr_lo)) {
        s_oc_above_count++;
    }

    if (s_oc_fill < OC_WINDOW_SAMPLES) {
        /* 填充期：被覆盖的是初始化时的 0，不是真实样本，不能对其做减法 */
        s_oc_fill++;
        if (s_oc_fill >= OC_WINDOW_SAMPLES) {
            s_oc_window_ready = true;
        }
    } else {
        /* 窗口已满：被覆盖的是真实样本，恢复其计数贡献 */
        if ((u16Old > s_oc_thr_hi) || (u16Old < s_oc_thr_lo)) {
            s_oc_above_count--;
        }
    }

    /* 校准期间累加原始码 */
    if (s_calibration_running) {
        s_calibration_sum += u16Raw;
        s_calibration_count++;
    }
}

/**
 * @brief 电压采样入滑动平均窗口（ISR 内调用，纯整数）
 */
static void OC_Vm_Accumulate(uint16_t u16Raw)
{
    uint16_t u16Old = s_vm_ring[s_vm_head];

    s_vm_ring[s_vm_head] = u16Raw;
    s_vm_head++;
    if (s_vm_head >= OC_VM_WINDOW_SAMPLES) {
        s_vm_head = 0;
    }
    s_vm_sum += u16Raw;
    s_vm_sum -= u16Old;
    if (s_vm_count < OC_VM_WINDOW_SAMPLES) {
        s_vm_count++;
    }
}

/**
 * @brief 50us 定时器 ISR：电流每 tick 采样（20kHz），电压每 OC_VM_DIV tick 采样（10kHz）
 */
void OC_50us_CallBack(void)
{
    uint16_t u16Raw;

    /* 直接写寄存器清比较匹配标志：绕开 DDL TIMER0_ClearFlag 内部 AsyncDelay 长延时
       （TMR02 chA 未初始化默认为 Async，AsyncDelay 会白跑约 400us，标志来不及清而死循环） */
    if (Set == TIMER0_GetFlag(M4_TMR02, Tim0_ChannelB)) {
        M4_TMR02->STFLR_f.CMBF = 0u;
    }

    u16Raw = OC_Adc1_ConvertChannel(ADCH_IVM_ADCH);
    OC_Accumulate(u16Raw);

    if ((s_oc_tick % OC_VM_DIV) == 0u) {
        u16Raw = OC_Adc1_ConvertChannel(ADCH_VM_ADCH);
        OC_Vm_Accumulate(u16Raw);
    }
    s_oc_tick++;
}

/**
 * @brief 1ms 门控（1ms 定时 ISR 调用，只置标志，不做任何比较）
 */
void OC_Gate_Tick(void)
{
    s_oc_gate = true;
}

/**
 * @brief 消费门控并更新过流判定（主循环调用，浮点只在主循环）
 */
static void OC_Process(void)
{
    bool bGate;

    __disable_irq();
    bGate = s_oc_gate;
    s_oc_gate = false;
    __enable_irq();

    if (!bGate) {
        return;
    }

    /* 运行时改 g_sys_ctx.Current_Limit_Upper 后自动重算阈值（含重置窗口，重填约 10ms） */
    if (g_sys_ctx.Current_Limit_Upper != s_oc_limit_last) {
        OC_UpdateThresholds();
        return;
    }

    if (!s_oc_window_ready || !s_calibration_done) {
        return;   /* 窗口未填满或校准未完成前不判定 */
    }

    s_oc_trip = ((float)s_oc_above_count * 100.0f / (float)OC_WINDOW_SAMPLES) >= OC_TRIP_PERCENT;
}

/**
 * @brief 当前过流判定结果
 */
bool OC_Get_TripFlag(void)
{
    return s_oc_trip;
}

/**
 * @brief 窗口就绪且校准完成（有有效数据可判定）
 */
static bool OC_IsWindowReady(void)
{
    return (s_oc_window_ready && s_calibration_done);
}

/**
 * @brief 窗口内平均电流（A）
 */
static float OC_Get_CurrentAvg(void)
{
    uint32_t u32N;
    float fAvgRaw;

    if (s_oc_fill == 0u) {
        return 0.0f;
    }
    u32N = (s_oc_fill < OC_WINDOW_SAMPLES) ? s_oc_fill : OC_WINDOW_SAMPLES;
    fAvgRaw = (float)(s_oc_ring_sum / u32N);
    return (fAvgRaw * ADC_REF_VOLTAGE / ADC_FULL_SCALE * 1000.0f - 1650.0f) / 66.0f + g_sys_ctx.current_offset;
}

/**
 * @brief 滑动窗口平均母线电压（V）
 */
static float OC_Get_VoltageAvg(void)
{
    float fAvgRaw;
    float fAdvmV;
    float fOff;

    if (s_vm_count == 0u) {
        return 0.0f;
    }
    fAvgRaw = (float)(s_vm_sum / s_vm_count);
    fAdvmV  = fAvgRaw * ADC_REF_VOLTAGE / ADC_FULL_SCALE;
    fOff    = (fAdvmV * (VM_R1 + VM_R2) / VM_R1) / 11.0f;
    return (fAdvmV * (VM_R1 + VM_R2) / VM_R1) + fOff;
}

/**
 * @brief 初始化 OC：状态清零 + 启动 50us TMR02 chB 中断
 */
void OC_Init(void)
{
    stc_tim0_base_init_t stcTimerCfg;
    stc_irq_regi_conf_t stcIrqRegiConf;
    stc_clk_freq_t stcClkTmp;
    uint32_t u32Pclk1;

    MEM_ZERO_STRUCT(stcTimerCfg);
    MEM_ZERO_STRUCT(stcIrqRegiConf);

    /* 清空 OC 状态 */
    memset(s_oc_ring, 0, sizeof(s_oc_ring));
    memset(s_oc_cur_ring_mA, 0, sizeof(s_oc_cur_ring_mA));
    s_oc_head = 0;
    s_oc_fill = 0;
    s_oc_ring_sum = 0;
    s_oc_above_count = 0;
    s_oc_gate = false;
    s_oc_trip = false;
    s_oc_window_ready = false;
    s_oc_thr_hi = 0xFFFFu;
    s_oc_thr_lo = 0u;
    s_oc_tick = 0u;

    memset(s_vm_ring, 0, sizeof(s_vm_ring));
    s_vm_head = 0;
    s_vm_count = 0;
    s_vm_sum = 0;

    s_calibration_sum = 0;
    s_calibration_count = 0;

    /* 50us 定时器：TMR02 chB（Sync/PCLK1；TMR01 chA 在 DDL 中仅限异步时钟，故改用 TMR02 chB） */
    CLK_GetClockFreq(&stcClkTmp);
    u32Pclk1 = stcClkTmp.pclk1Freq;

    PWC_Fcg2PeriphClockCmd(PWC_FCG2_PERIPH_TIM02, Enable);

    TIMER0_WriteCntReg(M4_TMR02, Tim0_ChannelB, 0u);

    stcTimerCfg.Tim0_CounterMode = Tim0_Sync;
    stcTimerCfg.Tim0_SyncClockSource = Tim0_Pclk1;
    stcTimerCfg.Tim0_ClockDivision = Tim0_ClkDiv0;   /* PCLK1/1，50us 计数更精确 */
    stcTimerCfg.Tim0_CmpValue = (uint16_t)(((uint64_t)OC_TIMER_US * u32Pclk1) / 1000000u) - 1u;
    TIMER0_BaseInit(M4_TMR02, Tim0_ChannelB, &stcTimerCfg);

    M4_TMR02->STFLR_f.CMBF = 0u;   /* 清标志（同理由：绕开 DDL AsyncDelay） */
    TIMER0_IntCmd(M4_TMR02, Tim0_ChannelB, Enable);

    stcIrqRegiConf.enIRQn = OC_TIMER_IRQN;              /* Int003 */
    stcIrqRegiConf.enIntSrc = INT_TMR02_GCMB;           /* TMR02 chB 比较匹配 */
    stcIrqRegiConf.pfnCallback = &OC_50us_CallBack;
    enIrqRegistration(&stcIrqRegiConf);

    NVIC_ClearPendingIRQ(OC_TIMER_IRQN);
    NVIC_SetPriority(OC_TIMER_IRQN, OC_TIMER_IRQ_PRIORITY);
    NVIC_EnableIRQ(OC_TIMER_IRQN);

    TIMER0_Cmd(M4_TMR02, Tim0_ChannelB, Enable);
}

/**
 * @brief 电流校准完成后更新过流阈值 ADC 码，并重置窗口
 */
void OC_UpdateThresholds(void)
{
    float fOffset = g_sys_ctx.current_offset;
    float fLimit  = g_sys_ctx.Current_Limit_Upper;   /* 运行时阈值（初始化 = THRESHOLD_CURRENT_OVER） */
    float fVmHi;
    float fVmLo;

    /* +-fLimit(A) -> mV -> 12bit ADC 码（参考 3.3V/4096） */
    fVmHi = 1650.0f + 66.0f * (fLimit - fOffset);
    fVmLo = 1650.0f - 66.0f * (fLimit + fOffset);
    s_oc_thr_hi = (uint16_t)(fVmHi * ADC_FULL_SCALE / (ADC_REF_VOLTAGE * 1000.0f));
    s_oc_thr_lo = (uint16_t)(fVmLo * ADC_FULL_SCALE / (ADC_REF_VOLTAGE * 1000.0f));

    s_oc_limit_last = fLimit;
    s_oc_offset_mA = (int32_t)(g_sys_ctx.current_offset * 1000.0f);   /* 校准偏移的定点(mA)，ISR 换算电流用 */

    /* 重置窗口，用校准后的数据重新填充 */
    memset(s_oc_ring, 0, sizeof(s_oc_ring));
    memset(s_oc_cur_ring_mA, 0, sizeof(s_oc_cur_ring_mA));
    s_oc_head = 0;
    s_oc_fill = 0;
    s_oc_ring_sum = 0;
    s_oc_above_count = 0;
    s_oc_window_ready = false;
    s_oc_trip = false;
}
/**
 * @brief 电机保护功能处理
 * @param motor_cmd 电机命令状态
 * @param cur_limit_valid 电流检测有效状态（用于判断是否在启动阶段）
 * @return 系统错误码
 */
volatile int protect_num = 0;
SystemError MotorProtect_Generate(MotorCmdState motor_cmd, CurrentLimitValidState cur_limit_valid)
{
    SystemError err = ERROR_NONE;
    s_motor_measure_valid = false;  // 重置测量有效性

    // 消费 1ms 门控，更新过流判定（浮点只在主循环）
    OC_Process();

    // 刷新测量值：直接读 50us ISR 结果，主循环不再轮询 ADC1
    s_motor_current = OC_Get_CurrentAvg();
    s_motor_voltage = OC_Get_VoltageAvg();

    switch (motor_cmd)
    {
        case MOTOR_STOP:
#ifdef ENABLE_UNDER_VOLTAGE_PROTECTION
            // 电机停止时重置欠压计数
            s_under_voltage_count = 0;
#endif

            // 过流判定（基于 50us OC 窗口，门控节流到 1ms 一次）
            if (OC_Get_TripFlag())
            {
                time_sample_current_over++;
                if (time_sample_current_over >= TIME_SAMPLE_CURRENT_OVER)
                {
                    s_motor_current_over = true;
                    err = ERROR_OVER_CURRENT;
                    protect_num = 1;
                }
            }
            else
            {
                s_motor_current_over = false;
                time_sample_current_over = 0;
            }

            // 无错误且有有效数据时标记测量有效
            if (err == ERROR_NONE && OC_IsWindowReady() && !OC_Get_TripFlag())
            {
                s_motor_measure_valid = true;
            }
            break;

        // MotorProtect_Generate 中的过压检测（方案二）
        case MOTOR_RUN_EXTEND:
        case MOTOR_RUN_RETRACT:
            // 只在电机运行状态下更新电压最低值
            if (s_motor_voltage < s_motor_voltage_min) {
                s_motor_voltage_min = s_motor_voltage;
            }

            // ========== 过压检测（最高优先级，独立检测） ==========
        #ifdef ENABLE_OVER_VOLTAGE_PROTECTION
            if (s_motor_voltage > THRESHOLD_VOLTAGE_OVER) {
                s_motor_measure_valid = false;
                err = ERROR_OVER_VOLTAGE;
                protect_num = 3;
                break;  // 过压时直接跳出
            }
        #endif

            // ========== 欠压检测 ==========
        #ifdef ENABLE_UNDER_VOLTAGE_PROTECTION
            bool is_startup_phase = (cur_limit_valid == CURRENT_LIMIT_VALID_OFF_POSITIVE ||
                                    cur_limit_valid == CURRENT_LIMIT_VALID_OFF_NEGATIVE);

            if (is_startup_phase) {
                s_under_voltage_count = 0;
            } else {
                if (s_motor_voltage < THRESHOLD_VOLTAGE_UNDER) {
                    s_under_voltage_count++;
                    if (s_under_voltage_count >= UNDER_VOLTAGE_DEBOUNCE_MS) {
                        s_motor_measure_valid = false;
                        err = ERROR_UNDER_VOLTAGE;
                        protect_num = 4;
                        break;
                    }
                } else {
                    s_under_voltage_count = 0;
                }
            }
        #endif

            // ========== 过流检测 ==========
            if (OC_Get_TripFlag())
            {
                time_sample_current_over++;
                if (time_sample_current_over >= TIME_SAMPLE_CURRENT_OVER)
                {
                    s_motor_current_over = true;
                    err = ERROR_OVER_CURRENT;
                    protect_num = 2;
                }
            }
            else
            {
                s_motor_current_over = false;
                time_sample_current_over = 0;
            }

            // 无错误时标记测量有效
            if (err == ERROR_NONE && OC_IsWindowReady() && !OC_Get_TripFlag())
            {
                s_motor_measure_valid = true;
            }
            break;

        default:
            // 未知指令重置状态
            s_motor_current = 0.0f;
            s_motor_voltage = 0.0f;
            s_motor_measure_valid = false;
            s_motor_current_over = false;
#ifdef ENABLE_UNDER_VOLTAGE_PROTECTION
            s_under_voltage_count = 0;
#endif
            break;
    }

    return err;
}

/**
 * @brief 电流采样通道初始化
 */
void ADC_CUR_Init(void)
{
    stc_adc_init_t stcAdcInit;
    MEM_ZERO_STRUCT(stcAdcInit);

    // ADC硬件初始化（HC32F4平台）
    CLK_SetPeriClkSource(ClkPeriSrcPclk);
    PWC_Fcg3PeriphClockCmd(PWC_FCG3_PERIPH_ADC1, Enable);

    stcAdcInit.enResolution = AdcResolution_12Bit;
    stcAdcInit.enDataAlign  = AdcDataAlign_Right;
    stcAdcInit.enAutoClear  = AdcClren_Disable;
    stcAdcInit.enScanMode   = AdcMode_SAOnce;
    ADC_Init(M4_ADC1, &stcAdcInit);

    // 注册电流通道到适配器层
    ADCH_t  VM_ADIVM = {ADCH_IVM_ADC, ADCH_IVM_ADCH, ADCH_IVM_PORT, ADCH_IVM_PIN};
    adc_adapter_hInit(&hADCChannalIVM, &VM_ADIVM);
    adc_adapter_Set_Channal_SmpTime(ADCH_IVM_ADCH, SampleTime_cur);
    adc_adapter_Set_Channal_SmpIntervalTime(ADCH_IVM_ADCH, SampleIntervalTime_cur);
    adc_adapter_Channel_Enable(ADCH_IVM_ADCH);
}

/**
 * @brief 电流采样数组比较（判断是否过流）- 使用动态校准偏移
 * @param CUR_Voltage_ptr 输出电流值
 * @return 比较结果（枚举）
 */
ADC_Compare_Result ADC_CUR_ARRAY_COMPARE(float* CUR_Voltage_ptr)
{
    static bool firstCall = true;
    static float converted_voltages_cur[SAMPLE_BUFFER_SIZE_cur] = {0};
    static float converted_voltages_cur_convert[SAMPLE_BUFFER_SIZE_cur] = {0};
    static uint32_t converted_count = 0;

    // 首次调用初始化
    if (firstCall) {
        firstCall = false;
        adc_adapter_Reset_Sampling_Stats(ADCH_IVM_ADCH);
        return ADC_COMPARE_INITIALIZING;
    }

    // 如果校准未完成，返回禁用状态
    if (!s_calibration_done) {
        return ADC_COMPARE_DISABLED;
    }

    // 执行电流采样
    int ADC_result = hz_adc_adapter_SCM_1Ch_Convert_CUR(ADCH_IVM_ADCH);

    if (1 == ADC_result)
    {
        uint16_t buffer_cur[SAMPLE_BUFFER_SIZE_cur];
        uint32_t count;
        bool all_above_threshold = true;

        // 获取采样缓冲区数据
        adc_adapter_Get_Sample_Buffer(ADCH_IVM_ADCH, buffer_cur, &count, SAMPLE_BUFFER_SIZE_cur);

        // 转换采样数据并判断是否过流
        converted_count = 0;
        for (uint32_t i = 0; i < count; i++) {
            float AD_CUR_Voltage_sample = (float)buffer_cur[i] * ADC_REF_VOLTAGE / ADC_FULL_SCALE * 1000;
            // 使用动态校准偏移量
            float CUR_Current_sample = (AD_CUR_Voltage_sample - 1650.0f) / 66 + g_sys_ctx.current_offset;

            converted_voltages_cur[converted_count] = AD_CUR_Voltage_sample;
            converted_voltages_cur_convert[converted_count] = CUR_Current_sample;
            converted_count++;
            ring_buffer_put(&current_buffer, CUR_Current_sample, RB_PUT_OVERWRITE);

            // 判断是否超过电流阈值
            if ((CUR_Current_sample <= g_sys_ctx.Current_Limit_Upper) &&
                (CUR_Current_sample >= (-1)*(g_sys_ctx.Current_Limit_Upper))) {
                all_above_threshold = false;
            }
        }

        // 计算平均电流值（使用动态校准偏移）
        uint16_t ADData_Current = adc_adapter_Get_Sampling_Average(ADCH_IVM_ADCH);
        float ADCUR_Voltage = (float)ADData_Current * ADC_REF_VOLTAGE / ADC_FULL_SCALE * 1000;
        *CUR_Voltage_ptr = (ADCUR_Voltage - 1650.0f) / 66 + g_sys_ctx.current_offset;

        // 重置采样状态
        adc_adapter_Reset_Sampling_Stats(ADCH_IVM_ADCH);

        return all_above_threshold ? ADC_COMPARE_ALL_ABOVE : ADC_COMPARE_NOT_ALL_ABOVE;
    }
    else if (0 == ADC_result)
    {
        return ADC_COMPARE_NOT_ENOUGH_SAMPLES;
    }
    else if (-1 == ADC_result)
    {
        return ADC_COMPARE_NOT_READY;
    }
    else if (-2 == ADC_result)
    {
        return ADC_COMPARE_DISABLED;
    }

    return ADC_COMPARE_DISABLED;
}

/**
 * @brief 电压采样通道初始化
 */
void ADC_VM_Init()
{
    stc_adc_init_t stcAdcInit;
    MEM_ZERO_STRUCT(stcAdcInit);

    // ADC硬件初始化（HC32F4平台）
    CLK_SetPeriClkSource(ClkPeriSrcPclk);
    PWC_Fcg3PeriphClockCmd(PWC_FCG3_PERIPH_ADC1, Enable);

    stcAdcInit.enResolution = AdcResolution_12Bit;
    stcAdcInit.enDataAlign  = AdcDataAlign_Right;
    stcAdcInit.enAutoClear  = AdcClren_Disable;
    stcAdcInit.enScanMode   = AdcMode_SAOnce;
    ADC_Init(M4_ADC1, &stcAdcInit);

    // 注册电压通道到适配器层
    ADCH_t  VM_ADCH = {ADCH_VM_ADC, ADCH_VM_ADCH, ADCH_VM_PORT, ADCH_VM_PIN};
    adc_adapter_hInit(&hADCChannalMBV, &VM_ADCH);
    adc_adapter_Set_Channal_SmpTime(ADCH_VM_ADCH, SampleTime_vm);
    adc_adapter_Set_Channal_SmpIntervalTime(ADCH_VM_ADCH, SampleIntervalTime_vm);
    adc_adapter_Channel_Enable(ADCH_VM_ADCH);
}

/**
 * @brief 电压采样处理
 * @param VM_Voltage_ptr 输出电压值
 */
/**
 * @brief 电压采样处理（读取 50us ISR 维护的滑动平均，不轮询 ADC1）
 * @param VM_Voltage_ptr 输出电压值
 */
void ADC_VM(float* VM_Voltage_ptr)
{
    if (VM_Voltage_ptr != NULL) {
        *VM_Voltage_ptr = OC_Get_VoltageAvg();
    }
}

/******************************新增接口实现*******************************/

/**
 * @brief 获取电压最低值
 * @return 电压最低值
 */
float MotorProtect_GetVoltageMin(void)
{
    return s_motor_voltage_min;
}

/**
 * @brief 重置电压最低值记录
 */
void MotorProtect_ResetVoltageMin(void)
{
    s_motor_voltage_min = 999.9f;
}

/******************************电流校准接口实现*******************************/

/**
 * @brief 启动电流零点校准
 * 上电后调用，电机必须处于停止状态；50us ISR 持续累加电流原始码
 */
void ADC_CURRENT_Calibration_Start(void)
{
    // 复位校准状态
    s_calibration_running = true;
    s_calibration_done = false;
    s_calibration_offset = 0.0f;
    s_calibration_sum = 0;
    s_calibration_count = 0;

    // 启动定时器（CALIBRATION_TIME 单位 ms）
    nbDelay_Init(&s_calibration_delay, CALIBRATION_TIME);
    nbDelay_Start(&s_calibration_delay);
}

/**
 * @brief 执行电流校准（等待 ISR 采够数据后取平均）
 * @return true=校准完成，false=校准中
 */
bool ADC_CURRENT_Calibration_Process(void)
{
    if (!s_calibration_running) {
        return s_calibration_done;
    }

    if (nbDelay_IsComplete(&s_calibration_delay)) {
        if (s_calibration_count > 0) {
            // ISR 累加的是原始码：平均值 -> mV -> 电流（不加偏移）
            float fAvgRaw = (float)s_calibration_sum / (float)s_calibration_count;
            float fAvgMv  = fAvgRaw * ADC_REF_VOLTAGE / ADC_FULL_SCALE * 1000.0f;
            s_calibration_offset = (fAvgMv - 1650.0f) / 66.0f;

            // 存储到全局上下文
            g_sys_ctx.current_offset = s_calibration_offset;
        } else {
            // 如果没有采集到数据，使用默认值0
            s_calibration_offset = 0.0f;
            g_sys_ctx.current_offset = 0.0f;
        }

        s_calibration_running = false;
        s_calibration_done = true;
        return true;
    }

    return false;
}

/**
 * @brief 检查校准是否完成
 */
bool ADC_CURRENT_Calibration_IsDone(void)
{
    return s_calibration_done;
}

/**
 * @brief 获取校准偏移值
 */
float ADC_CURRENT_GetOffset(void)
{
    return s_calibration_offset;
}

/**
 * @brief 设置偏移值（用于外部注入）
 */
void ADC_CURRENT_SetOffset(float offset)
{
    s_calibration_offset = offset;
    g_sys_ctx.current_offset = offset;
}
