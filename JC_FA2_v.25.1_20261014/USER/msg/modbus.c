/********************************文件说明*************************************
*文件名: modbus.c

*作者: Yuchen Tan

*版本: V1.0.1

*功能简介:
*1.modbus-rtu协议栈;

*备注:

*修改履历:
------------------------------------V1.0.1------------------------------------
*20230927: 1、增加保存从机地址的变量
		   2、增加03功能码的回调函数注册
*****************************************************************************/

/*****************************文件包含(私有)**********************************
*
*备注: 无
*
*****************************************************************************/
#include "modbus.h"
/*****************************宏定义(私有)************************************
*
*备注: 本文件中,不希望被外部使用或随意修改的宏在这里定义
*
*****************************************************************************/

/**************************数据类型及结构定义(私有)***************************
*
*备注: 本文件中,不希望被外部使用的数据结构及类型在这里定义
*
*****************************************************************************/
/*modbus寄存器操作指令定义*/
typedef enum
{
    E_REG_WRITE = 0,
    E_REG_READ,
}MB_REG_OP_t;
/*****************************函数声明(私有)**********************************
*
*备注: 本文件中,不希望被外部调用的函数统一在这里声明
*
*****************************************************************************/

/********************************变量定义*************************************
*
*备注: 不要在.h中定义变量,防止多个.c包含这个.h,导致编译后报错变量重复定义
*
*****************************************************************************/
/* 高位字节的 CRC 值 */
const static uint8_t auchCRCHi[] = {
    0x00, 0xC1, 0x81, 0x40, 0x01, 0xC0, 0x80, 0x41, 0x01, 0xC0, 0x80, 0x41, 0x00, 0xC1, 0x81,
    0x40, 0x01, 0xC0, 0x80, 0x41, 0x00, 0xC1, 0x81, 0x40, 0x00, 0xC1, 0x81, 0x40, 0x01, 0xC0,
    0x80, 0x41, 0x01, 0xC0, 0x80, 0x41, 0x00, 0xC1, 0x81, 0x40, 0x00, 0xC1, 0x81, 0x40, 0x01,
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    0x00, 0xC1, 0x81, 0x40, 0x01, 0xC0, 0x80, 0x41, 0x01, 0xC0, 0x80, 0x41, 0x00, 0xC1, 0x81,
    0x40
} ;
/* 低位字节的 CRC 值 */
const static uint8_t auchCRCLo[] = {
    0x00, 0xC0, 0xC1, 0x01, 0xC3, 0x03, 0x02, 0xC2, 0xC6, 0x06, 0x07, 0xC7, 0x05, 0xC5, 0xC4,
    0x04, 0xCC, 0x0C, 0x0D, 0xCD, 0x0F, 0xCF, 0xCE, 0x0E, 0x0A, 0xCA, 0xCB, 0x0B, 0xC9, 0x09,
    0x08, 0xC8, 0xD8, 0x18, 0x19, 0xD9, 0x1B, 0xDB, 0xDA, 0x1A, 0x1E, 0xDE, 0xDF, 0x1F, 0xDD,
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    0x44, 0x84, 0x85, 0x45, 0x87, 0x47, 0x46, 0x86, 0x82, 0x42, 0x43, 0x83, 0x41, 0x81, 0x80,
    0x40
};
/********************************函数定义************************************
*函数名:

*函数功能描述: modbus协议栈-CRC

*函数参数:

*函数返回值:

*备注:
*****************************************************************************/
/*MODBUS-CRC16计算*/
static uint16_t modbus_CRC16(const uint8_t *Data, uint8_t DataLen)
{
    uint8_t uchCRCHi = 0xFF ;   /* CRC 的高字节初始化 */
    uint8_t uchCRCLo = 0xFF ;   /* CRC 的低字节初始化 */
    uint8_t uIndex ;            /* CRC 查询表索引 */
    while (DataLen--) /* 完成整个报文缓冲区 */
    {
        uIndex = uchCRCLo ^ *Data++ ; /* 计算 CRC */
        uchCRCLo = uchCRCHi ^ auchCRCHi[uIndex];
        uchCRCHi = auchCRCLo[uIndex];
    }
#if 0
    return (uchCRCHi << 8 | uchCRCLo) ;
#else
    return (uchCRCLo << 8 | uchCRCHi) ;
#endif
}
/********************************函数定义************************************
*函数名:

*函数功能描述: modbus协议栈-寄存器索引表操作

*函数参数:

*函数返回值:

*备注:
*****************************************************************************/
/*获取寄存器在索引表中的指针*/
static MB_REG_KVP_t* modbus_Search_RegTable(MB_REG_KVP_t *RegTable, uint16_t RegAddr)
{
    if(!RegTable)
        return 0;
    MB_REG_KVP_t *RegKVPIndex = RegTable;
    while(RegKVPIndex->RegAddr != 0xFFFF)
    {
        if(RegKVPIndex->RegAddr == RegAddr)
            return RegKVPIndex;
        else
            RegKVPIndex++;
    }
    return 0;   //遍历整个表也没找到
}
/*遍历寄存器索引表*/
static uint16_t modbus_Traverse_RegTable(MB_REG_KVP_t *RegTable)
{
    if(!RegTable)
        return 0;
    uint16_t RegItemNb = 0;
    MB_REG_KVP_t *RegKVPIndex = RegTable;
    while(RegKVPIndex->RegAddr != 0xFFFF)
    {
        RegItemNb++;
        RegKVPIndex++;
    }
    return RegItemNb;
}
///*遍历寄存器索引表*/
//static uint16_t modbus_Get_RegNb(MB_CTRL_t* MBCtrl)
//{
//  return MBCtrl->RegNb;
//}
/*访问寄存器索引表(寄存器<-->缓存)*/
static void modbus_Access_RegTable(MB_REG_KVP_t *RegTable, uint16_t StartAddr, uint16_t RegNb, uint8_t *Buf, MB_REG_OP_t Cmd)
{
    MB_REG_KVP_t *RegKVPIndex = modbus_Search_RegTable(RegTable, StartAddr);
    uint16_t RegValue = 0;

    if(Cmd == E_REG_READ)       //寄存器表-->缓存
    {
        while(RegNb--)
        {
            RegValue = RegKVPIndex->RegValue;
            *Buf++ = (uint8_t)(RegValue >> 8);  //类型转换的()比>>运算优先级高,右边操作数必须带()
            *Buf++ = (uint8_t)(RegValue & 0xFF);
            RegKVPIndex++;
        }
    }else //Cmd == E_REG_WRITE  //缓存-->寄存器表
    {
        while(RegNb--)
        {
            RegValue = *Buf++ << 8; //*Buf++ << 8执行顺序: 取值-->移位-->指针自加-->赋值?
            RegValue |= *Buf++;
            RegKVPIndex->RegValue = RegValue;
            RegKVPIndex++;
        }
    }
}
/*读寄存器接口*/
uint16_t modbus_Read_1Reg(MB_REG_KVP_t *RegTable, uint16_t RegAddr)
{
    MB_REG_KVP_t *RegKVPIndex = modbus_Search_RegTable(RegTable, RegAddr);

    return RegKVPIndex->RegValue;
}
/*写寄存器接口*/
void modbus_Write_1Reg(MB_REG_KVP_t *RegTable, uint16_t RegAddr, uint16_t Value)
{
    MB_REG_KVP_t *RegKVPIndex = modbus_Search_RegTable(RegTable, RegAddr);

    RegKVPIndex->RegValue = Value;
}
/********************************函数定义************************************
*函数名:

*函数功能描述: modbus协议栈-初始化

*函数参数:

*函数返回值:

*备注:
*****************************************************************************/
/*协议栈控制器初始化*/
int8_t modbus_hInit(MB_CTRL_t* MBCtrl, uint8_t NodeType, uint8_t SlaveAddr, MB_REG_KVP_t *RegTable)
{
    MBCtrl->NodeType = NodeType;
    if(NodeType == MB_NODE_SLAVE)
        MBCtrl->SlaveAddr = SlaveAddr;
    else
        MBCtrl->SlaveAddr = 0;
    MBCtrl->LastSlaveAddr = 0;
    MBCtrl->State = MB_READY;
    MBCtrl->TimerEn = 0;
    MBCtrl->Timer = 0;
    MBCtrl->XfFlag = 0;
    MBCtrl->MsgErr = 0;
    memset(&MBCtrl->MsgSend, 0, sizeof(MB_RTU_MSG_t));
    memset(&MBCtrl->MsgRcv, 0, sizeof(MB_RTU_MSG_t));
    if(RegTable)
    {
        MBCtrl->RegTable = RegTable;
        MBCtrl->RegNb = modbus_Traverse_RegTable(RegTable);
    }
    return MB_RET_OK;
}
/*协议栈回调函数注册-从机应答*/
int8_t modbus_Reg_CallBack_Ack(MB_CTRL_t* MBCtrl, pfDataSend_t pf)
{
    MBCtrl->pfSlaveAck = pf;    //注: pf==0是合法参数,表示取消回调函数注册
    return MB_RET_OK;
}
/*协议栈回调函数注册-功能码处理回调函数*/
int8_t modbus_Reg_CallBack_FuncHandlerCB(MB_CTRL_t* MBCtrl, pfHandlerCB_t pf, uint8_t Func)
{
    //注: pf==0是合法参数,表示取消回调函数注册
    if(Func == MB_FUNC_WRITE_1_REG)
        MBCtrl->pfCB06 = pf;
    else if(Func == MB_FUNC_WRITE_REGS)
        MBCtrl->pfCB16 = pf;
    else if(Func == MB_FUNC_READ_HOLDING_REG)
        MBCtrl->pfCB03 = pf;
    else
        return MB_RET_ERR_PARAM;
    return MB_RET_OK;
}
/********************************函数定义************************************
*函数名:

*函数功能描述: modbus协议栈-RTU格式数据打包/解包

*函数参数:
@ *UpkMsg: 未打包用户数据
@ *PkMsg: 打包后的modbus报文

*函数返回值:

*备注:
*****************************************************************************/
/*数据打包*/
int8_t modbus_rtu_Pack(MB_CTRL_t* MBCtrl, const uint8_t *UpkMsg, uint8_t UpkMsgLen)
{
    uint16_t Crc16 = 0;
    uint8_t *Msg = MBCtrl->MsgSend.Msg;

    if(!UpkMsgLen || UpkMsgLen < MB_MSG_SIZE_MIN)
        return MB_RET_ERR_PARAM;
    /*装填发送消息缓存*/
    Crc16 = modbus_CRC16(UpkMsg, UpkMsgLen);
    memcpy(Msg, UpkMsg, UpkMsgLen);
    Msg[UpkMsgLen] = (uint8_t)(Crc16>>8);
    Msg[UpkMsgLen + 1] = (uint8_t)Crc16;
    MBCtrl->MsgSend.MsgLen = UpkMsgLen + MB_MSG_CRC_SIZE;
    return MB_RET_OK;
}
/*数据解包*/
int8_t modbus_rtu_Unpack(MB_CTRL_t* MBCtrl, uint8_t *PkMsg, uint8_t PkMsgLen)
{
    uint16_t Crc16 = 0;
    uint8_t *Msg = MBCtrl->MsgRcv.Msg;

    if(!PkMsg || PkMsgLen <= MB_MSG_ADDR_SIZE + MB_MSG_CRC_SIZE)
        return MB_RET_ERR_PARAM;
    Crc16 = (PkMsg[PkMsgLen - 2] << 8) | PkMsg[PkMsgLen - 1];   //CRC位于modbus最后2字节
    if(Crc16 != modbus_CRC16(PkMsg, PkMsgLen - MB_MSG_CRC_SIZE))
        return MB_RET_ERR_CRC;
    //解析成功数据拷贝存入接收消息缓存
    MBCtrl->MsgRcv.MsgLen = PkMsgLen;
    memcpy(Msg, PkMsg, PkMsgLen);
    return MB_RET_OK;
}
/********************************函数定义************************************
*函数名:

*函数功能描述: modbus协议栈-不同功能码处理

*函数参数:

*函数返回值:

*备注:
*****************************************************************************/
/*03功能码处理(读保持寄存器)*/
static int8_t modbus_Func_Handler_03(MB_CTRL_t* MBCtrl, uint8_t* AckLen)
{
    uint8_t *SndData = MBCtrl->MsgSend.Msg;
    uint8_t *RcvData = MBCtrl->MsgRcv.Msg;
    uint16_t RegStartAddr = 0;
    uint16_t RegNb = 0;
    uint8_t ByteNb = 0;
    /*主机接收消息处理*/
    if(MBCtrl->NodeType == MB_NODE_HOST)
    {
        RegStartAddr = SndData[MB_PDU_OFFSET_FUNC03_REGADDR] << 8;
        RegStartAddr |= SndData[MB_PDU_OFFSET_FUNC03_REGADDR + 1];

        ByteNb = RcvData[MB_PDU_OFFSET_FUNC03_BYTENB];
        if(ByteNb <= 125 * 2)
            modbus_Access_RegTable(MBCtrl->RegTable, RegStartAddr, ByteNb/2, &RcvData[MB_PDU_OFFSET_FUNC03_REGVALUE], E_REG_WRITE);
    }
    /*从机接收消息处理*/
    else    //MBCtrl->NodeType == MB_NODE_SLAVE
    {
        RegStartAddr = RcvData[MB_PDU_OFFSET_FUNC03_REGADDR] << 8;
        RegStartAddr |= RcvData[MB_PDU_OFFSET_FUNC03_REGADDR + 1];

        RegNb = RcvData[MB_PDU_OFFSET_FUNC03_REGNB] << 8;
        RegNb |= RcvData[MB_PDU_OFFSET_FUNC03_REGNB + 1];

        if(RegNb == 0 || RegNb > 125)
        {
            //读取寄存器个数异常
            SndData[MB_ADU_OFFSET_ADDR] = MBCtrl->SlaveAddr;
            SndData[MB_PDU_OFFSET_FUNC] = MB_FUNC_ATTACH_ERR | MB_FUNC_READ_HOLDING_REG;
            SndData[MB_PDU_OFFSET_ERR]  = 0x0f;     //Todo: 读取寄存器数量错误处理
            *AckLen = 3;
            return MB_RET_ERR_REG;
        }else if(modbus_Search_RegTable(MBCtrl->RegTable, RegStartAddr + RegNb - 1) == 0)
        {
            //读取寄存器范围越界
            SndData[MB_ADU_OFFSET_ADDR] = MBCtrl->SlaveAddr;
            SndData[MB_PDU_OFFSET_FUNC] = MB_FUNC_ATTACH_ERR | MB_FUNC_READ_HOLDING_REG;
            SndData[MB_PDU_OFFSET_ERR]  = 0x0e;     //Todo: 读取寄存器数量错误处理
            *AckLen = 3;
            return MB_RET_ERR_REG;
        }else
        {
            //可正确读取寄存器
            modbus_Access_RegTable(MBCtrl->RegTable, RegStartAddr, RegNb, &SndData[MB_PDU_OFFSET_FUNC03_REGVALUE], E_REG_READ);
            SndData[MB_ADU_OFFSET_ADDR] = MBCtrl->SlaveAddr;
            SndData[MB_PDU_OFFSET_FUNC] = MB_FUNC_READ_HOLDING_REG;
            SndData[MB_PDU_OFFSET_FUNC03_BYTENB] = RegNb * 2;
            *AckLen = RegNb * 2 + 3;    //+3: 地址byte[0] + 功能码byte[1] + 字节数byte[2]
        }
    }
    return MB_RET_OK;
}
/*06功能码处理(写单个寄存器)*/
static int8_t modbus_Func_Handler_06(MB_CTRL_t* MBCtrl, uint8_t* AckLen)
{
    uint8_t *SndData = MBCtrl->MsgSend.Msg;
    uint8_t *RcvData = MBCtrl->MsgRcv.Msg;
    uint16_t RegAddr = 0;
    /*主机接收消息处理*/
    if(MBCtrl->NodeType == MB_NODE_HOST)
    {
        //Todo: 主机可根据从机应答数据判断写入值是否正确(没必要,能执行此函数说明从机已正确收到主机的写请求数据包)
    }
    /*从机接收消息处理*/
    else    //MBCtrl->NodeType == MB_NODE_SLAVE
    {
        RegAddr = RcvData[MB_PDU_OFFSET_FUNC06_REGADDR] << 8;
        RegAddr |= RcvData[MB_PDU_OFFSET_FUNC06_REGADDR + 1];

        if(modbus_Search_RegTable(MBCtrl->RegTable, RegAddr) == 0)
        {
            //写人寄存器范围越界
            SndData[MB_ADU_OFFSET_ADDR] = MBCtrl->SlaveAddr;
            SndData[MB_PDU_OFFSET_FUNC] = MB_FUNC_ATTACH_ERR | MB_FUNC_WRITE_1_REG;
            SndData[MB_PDU_OFFSET_ERR]  = 0x0f;     //Todo: 读取寄存器数量错误处理
            *AckLen = 3;
            return MB_RET_ERR_REG;
        }else
        {
            //可正确写入寄存器
            modbus_Access_RegTable(MBCtrl->RegTable, RegAddr, 1, &RcvData[MB_PDU_OFFSET_FUNC06_REGVALUE], E_REG_WRITE);
            memcpy(SndData, RcvData, 6);
            *AckLen = 6;
        }
    }
    return MB_RET_OK;
}
/*16功能码处理(写多个寄存器)*/
static int8_t modbus_Func_Handler_16(MB_CTRL_t* MBCtrl, uint8_t* AckLen)
{
    uint8_t *SndData = MBCtrl->MsgSend.Msg;
    uint8_t *RcvData = MBCtrl->MsgRcv.Msg;
    uint16_t RegStartAddr = 0;
    uint16_t RegNb = 0;
//    uint8_t ByteNb = 0;
    /*主机接收消息处理*/
    if(MBCtrl->NodeType == MB_NODE_HOST)
    {
        RegStartAddr = RcvData[MB_PDU_OFFSET_FUNC16_REGADDR] << 8;
        RegStartAddr |= RcvData[MB_PDU_OFFSET_FUNC16_REGADDR + 1];

        RegNb = RcvData[MB_PDU_OFFSET_FUNC16_REGNB] << 8;
        RegNb |= RcvData[MB_PDU_OFFSET_FUNC16_REGNB + 1];

        //Todo: 从机应答正确性判断?
    }
    /*从机接收消息处理*/
    else    //MBCtrl->NodeType == MB_NODE_SLAVE
    {
        RegStartAddr = RcvData[MB_PDU_OFFSET_FUNC16_REGADDR] << 8;
        RegStartAddr |= RcvData[MB_PDU_OFFSET_FUNC16_REGADDR + 1];

        RegNb = RcvData[MB_PDU_OFFSET_FUNC16_REGNB] << 8;
        RegNb |= RcvData[MB_PDU_OFFSET_FUNC16_REGNB + 1];

//        ByteNb = RcvData[MB_PDU_OFFSET_FUNC16_BYTENB];

        if(RegNb == 0 || RegNb > 0x78)
        {
            //写入指令寄存器个数异常
            SndData[MB_ADU_OFFSET_ADDR] = MBCtrl->SlaveAddr;
            SndData[MB_PDU_OFFSET_FUNC] = MB_FUNC_ATTACH_ERR | MB_FUNC_WRITE_REGS;
            SndData[MB_PDU_OFFSET_ERR]  = 0x0f;     //Todo: 读取寄存器数量错误处理
            *AckLen = 3;
            return MB_RET_ERR_REG;
        }else if(modbus_Search_RegTable(MBCtrl->RegTable, RegStartAddr + RegNb - 1) == 0)
        {
            //写入指令寄存器范围越界
            SndData[MB_ADU_OFFSET_ADDR] = MBCtrl->SlaveAddr;
            SndData[MB_PDU_OFFSET_FUNC] = MB_FUNC_ATTACH_ERR | MB_FUNC_WRITE_REGS;
            SndData[MB_PDU_OFFSET_ERR]  = 0x0e;     //Todo: 读取寄存器数量错误处理
            *AckLen = 3;
            return MB_RET_ERR_REG;
        }else
        {
            //可正确写入寄存器
            modbus_Access_RegTable(MBCtrl->RegTable, RegStartAddr, RegNb, &RcvData[MB_PDU_OFFSET_FUNC16_REGVALUE], E_REG_WRITE);
            memcpy(SndData, RcvData, 6);
            *AckLen = 6;
        }
    }
    return MB_RET_OK;
}
/*错误码处理*/
static int8_t modbus_Func_Handler_Err(MB_CTRL_t* MBCtrl, uint8_t *AckLen, uint8_t Func)
{
    uint8_t *SndData = MBCtrl->MsgSend.Msg;
    //uint8_t *RcvData = MBCtrl->MsgRcv.Msg;
    if(MBCtrl->NodeType == MB_NODE_HOST)
    {
        if(Func > MB_FUNC_ATTACH_ERR)
        {
            Func -= MB_FUNC_ATTACH_ERR;
            //Todo: 主机收到从机回复的错误处理
        }
    }else   //MBCtrl->NodeType == MB_NODE_SLAVE
    {
        //从机收到未定义功能码
        SndData[MB_ADU_OFFSET_ADDR] = MBCtrl->SlaveAddr;
        SndData[MB_PDU_OFFSET_FUNC] = MB_FUNC_ATTACH_ERR;
        SndData[MB_PDU_OFFSET_ERR]  = 0x0f;     //Todo: 读取寄存器数量错误处理
        *AckLen = 3;
    }
    return MB_RET_OK;
}
/*不同功能码功能处理入口*/
int8_t uart_adapter_Transmit_Polling(uint8_t Channel, const uint8_t *Data, uint16_t Len);
void modbus_Func_Handler(MB_CTRL_t* MBCtrl, uint8_t Interface)
{
    MB_RTU_MSG_t RcvMsg = MBCtrl->MsgRcv;
    uint8_t Func = RcvMsg.Msg[MB_PDU_OFFSET_FUNC];
    uint8_t AckLen = 0;     //从机应答数据包长度

    /*根据功能码执行对应任务*/
    switch(Func)
    {
        case MB_FUNC_READ_HOLDING_REG:
            if(MB_RET_OK == modbus_Func_Handler_03(MBCtrl, &AckLen))
            {
                if(MBCtrl->pfCB03 != NULL)
                    MBCtrl->pfCB03(RcvMsg.Msg, RcvMsg.MsgLen);
            }
            break;

        case MB_FUNC_WRITE_1_REG:
            if(MB_RET_OK == modbus_Func_Handler_06(MBCtrl, &AckLen))
            {
                if(MBCtrl->pfCB06 != NULL)
                    MBCtrl->pfCB06(RcvMsg.Msg, RcvMsg.MsgLen);
            }
            break;

        case MB_FUNC_WRITE_REGS:
            if(MB_RET_OK == modbus_Func_Handler_16(MBCtrl, &AckLen))
            {
                if(MBCtrl->pfCB16 != NULL)
                    MBCtrl->pfCB16(RcvMsg.Msg, RcvMsg.MsgLen);
            }
            break;

        default:
            modbus_Func_Handler_Err(MBCtrl, &AckLen, Func);
            break;
    }
    /*从机应答*/
    if(MBCtrl->NodeType == MB_NODE_SLAVE)
    {
    #if 1
        if(MBCtrl->pfSlaveAck != 0)
            MBCtrl->pfSlaveAck(Interface, (uint8_t*)MBCtrl->MsgSend.Msg, AckLen);   //注: 这里只将打包前数据装填到发送队列,发送不在这里!
    #else   //modbus数据应答遇到bug,阻隔发送队列的影响,测试直接通过uart底层发数据看还有没有问题(结论: 发送队列没问题,是串口中断式发送的问题)
        if(modbus_rtu_Pack(MBCtrl, MBCtrl->MsgSend.Msg, AckLen) == MB_RET_OK)
        {
            uart_adapter_Transmit_Polling(2, MBCtrl->MsgSend.Msg, MBCtrl->MsgSend.MsgLen);
        }
    #endif
    }
}
/********************************函数定义************************************
*函数名:

*函数功能描述: modbus协议栈-节点数据收发控制

*函数参数:

*函数返回值:

*备注:
*****************************************************************************/
/*读数据传输标志*/
uint8_t modbus_Get_XfFlag(MB_CTRL_t* MBCtrl, uint8_t XfFlag)
{
    return MBCtrl->XfFlag;
}
/*置数据传输标志*/
void modbus_Set_XfFlag(MB_CTRL_t* MBCtrl, uint8_t XfFlag)
{
    MBCtrl->XfFlag |= XfFlag;
}
/*清数据传输标志*/
void modbus_Clr_XfFlag(MB_CTRL_t* MBCtrl, uint8_t XfFlag)
{
    MBCtrl->XfFlag &= ~XfFlag;
}
/*获取消息发送完成信号*/
static MB_STATE_t modbus_Get_Sent(MB_CTRL_t* MBCtrl)
{
    uint8_t SendAddr = MBCtrl->MsgSend.Msg[MB_ADU_OFFSET_ADDR];

    if(!(MBCtrl->XfFlag & MB_XF_SEND_CPLT))
        return MB_READY;
    if(MBCtrl->NodeType == MB_NODE_HOST)
    {
        if(SendAddr == MB_ADDR_BD)
            return MB_HOST_WAIT_TD;
        else if(SendAddr <= MB_ADDR_SC_MAX)
            return MB_HOST_WAIT_ACK;
        else
        {
        }
    }else   //MBCtrl->NodeType == MB_NODE_SLAVE
    {
        //return 1;
    }
    return MB_READY;
}
/*获取消息接收完成信号*/
static uint8_t modbus_Get_Rcv(MB_CTRL_t* MBCtrl)
{
    uint8_t RcvAddr = MBCtrl->MsgRcv.Msg[MB_ADU_OFFSET_ADDR];
    uint8_t SendAddr = MBCtrl->MsgSend.Msg[MB_ADU_OFFSET_ADDR];

    if(!(MBCtrl->XfFlag & MB_XF_RCV_CPLT))
        return 0;
    if(MBCtrl->NodeType == MB_NODE_HOST)
    {
        if(RcvAddr == SendAddr)
            return 1;
    }else   //MBCtrl->NodeType == MB_NODE_SLAVE
    {
        if(RcvAddr == MBCtrl->SlaveAddr || RcvAddr == MBCtrl->LastSlaveAddr || RcvAddr == MB_ADDR_BD)
            return 1;
    }
    return 0;
}
/*判断是否处于可发送状态*/
BOOL modbus_Send_Ready(MB_CTRL_t* MBCtrl)
{
    if(MBCtrl->NodeType == MB_NODE_HOST)
    {
        if(MBCtrl->State == MB_READY)
            return TRUE;
    }else   //MB_NODE_SLAVE
    {
        if(MBCtrl->State == MB_SLAVE_ACK)
            return TRUE;
    }
    return FALSE;
}
/*定时计数器(1ms调用1次)*/
void modbus_Timer(MB_CTRL_t* MBCtrl)
{
    if(MBCtrl->TimerEn)
    {
        if(MBCtrl->Timer < 60000)
            MBCtrl->Timer++;
    }else
        MBCtrl->Timer = 0;
}
/*主节点控制器*/
void modbus_Host_Controller(MB_CTRL_t* MBCtrl)
{
    MB_STATE_t  State = MBCtrl->State;

    if(MBCtrl->NodeType != MB_NODE_HOST)
        return;
    /*主节点状态机*/
    if(State == MB_READY)
    {
        MBCtrl->TimerEn = 0;
        MBCtrl->Timer = 0;
        modbus_Clr_XfFlag(MBCtrl, MB_XF_RCV_CPLT);
        MBCtrl->State = modbus_Get_Sent(MBCtrl);
    }else if(State == MB_HOST_WAIT_TD)
    {
        MBCtrl->TimerEn = 1;
        if(MBCtrl->Timer >= MB_BP_PERIOD && MBCtrl->Timer >= MB_BSTD_TIME)
        {
            modbus_Clr_XfFlag(MBCtrl, MB_XF_SEND_CPLT);
            MBCtrl->State = MB_READY;
        }
    }else if(State == MB_HOST_WAIT_ACK)
    {
        MBCtrl->TimerEn = 1;
        if(modbus_Get_Rcv(MBCtrl))
        {
            if(MBCtrl->Timer >= MB_SP_PERIOD)
                MBCtrl->State = MB_HOST_MSG_HANDLE;
        }else
        {
            if(MBCtrl->Timer >= MB_SA_TIMEOUT)
            {
                modbus_Clr_XfFlag(MBCtrl, MB_XF_SEND_CPLT);
                MBCtrl->State = MB_READY;
            }
        }
    }else if(State == MB_HOST_MSG_HANDLE)
    {
        modbus_Clr_XfFlag(MBCtrl, MB_XF_SEND_CPLT);
        MBCtrl->State = MB_READY;
    }else
    {   //do nothing
    }
}
/*从节点控制器*/
void modbus_Slave_Controller(MB_CTRL_t* MBCtrl)
{
    MB_STATE_t  State = MBCtrl->State;
    int8_t Result = 0;

    if(MBCtrl->NodeType != MB_NODE_SLAVE)
        return;
    /*从节点状态机*/
    if(State == MB_READY)
    {
        if(modbus_Get_Rcv(MBCtrl))
        {
            MBCtrl->State = MB_SLAVE_CHECK_REQ;
        }
    }else if(State == MB_SLAVE_CHECK_REQ)
    {
        if(Result)
        {

        }else
        {
            MBCtrl->MsgErr = 1;
        }
        MBCtrl->State = MB_SLAVE_ACK;
    }else if(State == MB_SLAVE_ACK)
    {
        if(MBCtrl->MsgErr)
        {

        }else
        {

        }
        MBCtrl->State = MB_READY;
    }else
    {   //do nothing
    }
}
