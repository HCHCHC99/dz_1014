/********************************文件说明*************************************
*文件名: msgHandler.c

*作者: Yuchen Tan

*版本: V1.0.0

*功能简介:

*备注: 无

*修改履历:

*****************************************************************************/

/*****************************文件包含(私有)**********************************
*
*备注: 无
*
*****************************************************************************/
#include "msgHandler.h"
#include "modbus.h"
#include "queue.h"
#include "uart_adapter.h"
#include "main.h"
#include "system.h"
#include "mc_app.h"
/*****************************宏定义(私有)************************************
*
*备注: 本文件中,不希望被外部使用或随意修改的宏在这里定义
*
*****************************************************************************/
/*消息接口物理层定义*/
#define PHY_UART        (1)

/*消息接口数据链路层定义*/
#define LINK_MODBUS     (1)

/*消息发送控制标志*/
#define MSG_SEND_CPLT   (1<<0)
#define MSG_RCV_CPLT    (1<<1)
/**************************数据类型及结构定义(私有)***************************
*
*备注: 本文件中,不希望被外部使用的数据结构及类型在这里定义
*
*****************************************************************************/
/*消息处理器类型定义*/
typedef struct
{
    uint8_t     Interface;  /*数据接口索引*/
    uint8_t     PhyType;    /*数据接口-物理层接口类型*/
    void        *Phy;       /*数据接口-物理层接口控制器*/
    uint8_t     LinkType;   /*数据接口-链路层接口类型*/
    void        *Link;      /*数据接口-链路层接口控制器*/
    QUEUE_t     *QSend;     /*数据发送队列*/
    uint8_t     State;      /*消息控制器状态*/
}MSG_HANDLER_t;
/*****************************函数声明(私有)**********************************
*
*备注: 本文件中,不希望被外部调用的函数统一在这里声明
*
*****************************************************************************/
static void msgHandler_Test(void);
/********************************变量定义*************************************
*
*备注: 不要在.h中定义变量,防止多个.c包含这个.h,导致编译后报错变量重复定义
*
*****************************************************************************/
MSG_HANDLER_t   hMsgHandler[1];
MB_CTRL_t       hModbusLink;
UART_CTRL_t     hUartRS485;

/*modbus寄存器键值对索引表*/
MB_REG_KVP_t g_KVPTable[] =
{
    {MBREG_MOTOR_CMD, 0},
    {MBREG_MOTOR_TGTPOS, 0},
    {MBREG_MOTOR_STATE, 0},
    {MBREG_MOTOR_FAULT, 0},
    {MBREG_MOTOR_CURRENT_MA, 0},
    {MBREG_MOTOR_TARGETSPEED_RPM, 0},
    {MBREG_MOTOR_FDBKPOS, 0},
    {MBREG_BUS_VOLTAGE_MV, 0},
    {MBREG_SYSTEM_FAULT, 0},
    //无效寄存器值(暂定0xFFFF),作为索引表结束标志,必须放在结尾.
    {0xFFFF, 0},
};
/********************************函数定义************************************
*函数名:

*函数功能描述: 消息处理器-公共

*函数参数: 无

*函数返回值: 无

*备注:
*****************************************************************************/
/*获取句柄*/
MSG_HANDLER_t* msgHandler_Get_Handle(uint8_t Interface)
{
    return &hMsgHandler[Interface];
}
/*装填发送数据*/
int8_t msgHandler_hInit(MSG_HANDLER_t *MsgHandler, uint8_t Interface, uint8_t PhyType, void *Phy, uint8_t LinkType, void *Link)
{
    QUEUE_t *Queue = {0};

    MsgHandler->Interface = Interface;
    MsgHandler->PhyType = PhyType;
    MsgHandler->Phy = Phy;
    MsgHandler->LinkType = LinkType;
    MsgHandler->Link = Link;
    if(QOP_SUCCESS == queue_Create(&Queue))
    {
        MsgHandler->QSend = Queue;
    }else
    {
        return MSG_RET_ERR_MA;
    }
    return MSG_RET_OK;
}
/********************************函数定义************************************
*函数名:

*函数功能描述: 消息处理器-发送处理

*函数参数: 无

*函数返回值: 无

*备注:
*****************************************************************************/
/*发送数据(未打包)放入队列*/
int8_t msgHandler_Pop_SendData(uint8_t Interface, uint8_t *Data, uint8_t DataLen)
{
    MSG_HANDLER_t *MsgHandler = msgHandler_Get_Handle(Interface);

    if(!Data || !DataLen)
        return MSG_RET_ERR_PARAM;
    if(queue_Push(MsgHandler->QSend, Data, DataLen) != QOP_SUCCESS)
    {
        return QOP_ERR_DATA;
    }
    return MSG_RET_OK;
}
/*判断接口当前是否可发送数据*/
BOOL msgHandler_Send_Ready(MSG_HANDLER_t *MsgHandler)
{
    uint8_t Ready = 0;

    /*物理层就绪*/
    if(MsgHandler->PhyType == PHY_UART)
    {
        UART_CTRL_t *Handle = MsgHandler->Phy;
        if(uart_Transmit_Ready(Handle->Ins.Channel) == TRUE)
            Ready++;
    }
    /*链路层就绪*/
    if(MsgHandler->LinkType == LINK_MODBUS)
    {
        if(modbus_Send_Ready(MsgHandler->Link) == TRUE)
            Ready++;
    }
    return (BOOL)(Ready == 2);
}
/*发送数据*/
int8_t msgHandler_Send(MSG_HANDLER_t *MsgHandler)
{
    /*从发送队列获取未打包数据*/
    uint8_t *Data = queue_Get_HeadNode_Data(MsgHandler->QSend);
    uint8_t DataLen = queue_Get_HeadNode_DataSize(MsgHandler->QSend);
    /*链路层打包*/
    if(MsgHandler->LinkType == LINK_MODBUS)
    {
        MB_CTRL_t* Handle = MsgHandler->Link;
        if(modbus_rtu_Pack(Handle, Data, DataLen) == MB_RET_OK)
        {
            queue_Pop(MsgHandler->QSend, 0, 0);
            //更新指针,指向打包后数据
            Data = Handle->MsgSend.Msg;
            DataLen = Handle->MsgSend.MsgLen;
        }else
        {
            queue_Pop(MsgHandler->QSend, 0, 0);
            return MSG_RET_ERR_PACK;    //数据错误,不发送
        }
    }
    /*物理层发送*/
    if(MsgHandler->PhyType == PHY_UART)
    {
        UART_CTRL_t *Handle = MsgHandler->Phy;
        uart_adapter_Transmit_Polling(Handle->Ins.Channel, Data, DataLen);
    }
    return MSG_RET_OK;
}
/*判断接口是否发送完成*/
BOOL msgHandler_Send_Cplt(MSG_HANDLER_t *MsgHandler)
{
    BOOL Ret = FALSE;
    if(MsgHandler->PhyType == PHY_UART)
    {
        UART_CTRL_t *Handle = MsgHandler->Phy;
        if(uart_Get_State(Handle->Ins.Channel, UART_TC))
        {
            uart_Clr_State(Handle->Ins.Channel, UART_TC);
            Ret = TRUE;
        }
    }
    if(Ret == TRUE)
    {
        if(MsgHandler->LinkType == LINK_MODBUS)
        {
            modbus_Set_XfFlag(MsgHandler->Link, MB_XF_SEND_CPLT);
        }
    }
    return Ret;
}
/*发送处理器*/
void msgHandler_Send_Handler(MSG_HANDLER_t *MsgHandler)
{
    /*引入State互斥的原因: 由于硬件通过异步中断发数据,中断中就可置位msgHandler_Send_Ready()为真判断所需的硬件发送就绪标志!
      如果不加入互斥保证判断"发送完成"后再判断是否"可以发送",当QSend存在2条以上数据时,"可以发送"判断连续满足,导致连发2包粘包*/
    if(MsgHandler->State == 0)
    {
        //可以发送
        if(msgHandler_Send_Ready(MsgHandler) && (!queue_Empty(MsgHandler->QSend)))
        {
            if(msgHandler_Send(MsgHandler) == MSG_RET_OK)
                MsgHandler->State = 1;
        }
    }else
    {
        //发送完成
        if(msgHandler_Send_Cplt(MsgHandler))
        {
            MsgHandler->State = 0;
        }
    }
}
/********************************函数定义************************************
*函数名:

*函数功能描述: 消息处理器-接收处理

*函数参数: 无

*函数返回值: 无

*备注:
*****************************************************************************/
/*判断接口是否接收完成*/
BOOL msgHandler_Rcv_Cplt(MSG_HANDLER_t *MsgHandler, uint8_t *RcvData, uint16_t *RcvLen)
{
    BOOL Ret = FALSE;

    if(MsgHandler->PhyType == PHY_UART)
    {
        UART_CTRL_t *Handle = MsgHandler->Phy;
        if(uart_Get_Receive(Handle->Ins.Channel, RcvData, RcvLen) == UART_RET_OK)
        {
            Ret = TRUE;
        }
    }
    return Ret;
}
/*链路层解析*/
int8_t msgHandler_Parse_RcvMsg(MSG_HANDLER_t *MsgHandler, uint8_t *RcvMsg, uint16_t MsgLen)
{
    int8_t Ret = 0;
    if(MsgHandler->LinkType == LINK_MODBUS)
    {
        MB_CTRL_t* Handle = MsgHandler->Link;
        Ret = modbus_rtu_Unpack(Handle, RcvMsg, (uint8_t)MsgLen);   //强转uint8_t：modbus帧最大长度为255.
        if(Ret == MB_RET_OK)
        {
            modbus_Set_XfFlag(Handle, MB_XF_RCV_CPLT);
        }else if(Ret == MB_RET_ERR_CRC)
        {
            return MSG_RET_ERR_CRC;
        }
    }
    return MSG_RET_OK;
}
/*应用层处理*/
int8_t msgHandler_Msg_Handler(MSG_HANDLER_t *MsgHandler, uint8_t *RcvMsg, uint16_t MsgLen)
{
    if(MsgHandler->LinkType == LINK_MODBUS)
    {
        MB_CTRL_t* Handle = MsgHandler->Link;
        modbus_Func_Handler(Handle, MsgHandler->Interface);
    }
    return MSG_RET_OK;
}
/*接收处理器*/
void msgHandler_Receive_Handler(MSG_HANDLER_t *MsgHandler)
{
    uint8_t ReData[100] = {0};
    uint16_t ReByteNb = 0;

    /*判断数据接收完成*/
    if(msgHandler_Rcv_Cplt(MsgHandler, ReData, &ReByteNb))
    {
        if(msgHandler_Parse_RcvMsg(MsgHandler, ReData, ReByteNb) == MSG_RET_OK)
        {
            msgHandler_Msg_Handler(MsgHandler, 0, 0);
        }
    }
}
/********************************函数定义************************************
*函数名:

*函数功能描述: 消息处理器-模块入口

*函数参数: 无

*函数返回值: 无

*备注:
*****************************************************************************/
/*485寄存器值初始化*/
void msgHandler_mbReg_Init(void)
{
    //g_KVPTable[] = 0;

}
/*后台应用入口*/
void msgHandler_LoopTask(void)
{
    /*队列模块*/
    queue_Test();

    /*消息处理器模块*/
    msgHandler_Test();
    msgHandler_Send_Handler(&hMsgHandler[0]);
    msgHandler_Receive_Handler(&hMsgHandler[0]);

    /*链路层控制器模块*/
    modbus_Host_Controller(&hModbusLink);
    modbus_Slave_Controller(&hModbusLink);
    modbus_Reg_CallBack_FuncHandlerCB(&hModbusLink, system_msgHandler_MB_AppCB, MB_FUNC_WRITE_1_REG);
    modbus_Reg_CallBack_FuncHandlerCB(&hModbusLink, system_msgHandler_MB_AppCB, MB_FUNC_WRITE_REGS);

    /*物理层控制器模块*/
    uart_Test();
}
/*1ms定时任务入口*/
void msgHandler_Timer_1ms(void)
{
    modbus_Timer(&hModbusLink);
}
/*初始化任务入口*/
void msgHandler_Init(void)
{
    /*消息接口初始化-物理层*/
    UART_INS_t UartConfig = {UART_485, UART3};
    uart_hInit(&hUartRS485, &UartConfig, 0);
//  uart_adapter_Func_Sel(uart_Get_Handle(UART3), UART_FUNC_RXNE_IE, UART_FUNC_ENABLE);
//  uart_adapter_Func_Sel(uart_Get_Handle(UART3), UART_FUNC_IDLE_IE, UART_FUNC_ENABLE);

    /*消息接口初始化-链路层*/
#if 0   //主机
    modbus_hInit(&hModbusLink, MB_NODE_HOST, 0, g_KVPTable);
#else   //从机
    modbus_hInit(&hModbusLink, MB_NODE_SLAVE, MB_NODE_SLAVE_ADDR, g_KVPTable);
    modbus_Reg_CallBack_Ack(&hModbusLink, msgHandler_Pop_SendData);
#endif

    /*消息控制器初始化*/
    msgHandler_mbReg_Init();
    msgHandler_hInit(&hMsgHandler[0], 0, PHY_UART, &hUartRS485, LINK_MODBUS, &hModbusLink);
}
/********************************函数定义************************************
*函数名:

*函数功能描述: 消息处理器-模块测试

*函数参数: 无

*函数返回值: 无

*备注:
*****************************************************************************/
static void msgHandler_Test(void)
{
    static uint8_t s_TestMsgHandler = 0;
    static uint8_t s_SendData[30] = {0};
    static uint8_t s_SendFrameNb = 10;
    static uint8_t s_Data = 0;
    static uint8_t s_Addr = MB_NODE_SLAVE_ADDR;
    static uint16_t s_RegStart = 0x0000;
    static uint16_t s_RegNb = 10;

    if(s_TestMsgHandler == 1)   //串口调试工具测试数据收发
    {
        s_TestMsgHandler = 0;
        for(uint8_t i = 0; i < s_SendFrameNb; i++)  //可通过调试器修改s_SendFrameNb的值进行测试
        {
            memset(s_SendData, s_Data, sizeof s_SendData / sizeof s_SendData[0]);
            msgHandler_Pop_SendData(0, s_SendData, sizeof s_SendData / sizeof s_SendData[0]);
            s_Data++;
        }
    }
    if(s_TestMsgHandler == 2)   //modbus Poll/Slave调试工具测试
    {
        s_TestMsgHandler = 0;
        for(uint8_t i = 0; i < s_SendFrameNb; i++)  //可通过调试器修改s_SendFrameNb的值进行测试
        {
            memset(s_SendData, 0, 10);
            s_SendData[0] = s_Addr;
            s_SendData[1] = MB_FUNC_READ_HOLDING_REG;
            s_SendData[2] = (uint8_t)(s_RegStart>>8);
            s_SendData[3] = (uint8_t)s_RegStart;
            s_SendData[4] = (uint8_t)(s_RegNb>>8);
            s_SendData[5] = (uint8_t)s_RegNb;
            msgHandler_Pop_SendData(0, s_SendData, 6);
        }
    }
    if(s_TestMsgHandler == 3)
    {
        s_TestMsgHandler = 0;
        memset(s_SendData, 0, 20);
        uart_adapter_Transmit_Polling(UART3, s_SendData, 20);
    }
}
