/********************************文件说明*************************************
*文件名: btn_drv.c

*作者: Yuchen Tan

*版本: V1.1.2

*功能简介: 按钮设备驱动-普通IO输入按钮设备

*备注: Todo:
1.整合IO和矩阵按钮驱动器,向上层开放抽象接口,抽象接口内部通过Type区分,并调用不同
  按钮驱动器的函数.

*修改履历:
------------------------------------V1.1.0------------------------------------
*20221114:
1.按钮IO操作改用gpio_adapter模块的抽象接口
2.整合常规IO按钮驱动+矩阵IO按钮驱动
------------------------------------V1.1.1------------------------------------
*20230224:
1.增加变量g_BtnDrvExistFlag, 用于接口参数检查,判断指定的按钮驱动器实例是否存在.
------------------------------------V1.1.2------------------------------------
20230309:
1.使用#error替换btn_drv.h的宏定义BTN_DRV_NB_LIMIT,实现在编译阶段的参数检查并报错超限!
*****************************************************************************/

/*****************************文件包含(私有)**********************************
*
*备注: 无
*
*****************************************************************************/
#include "btn_drv.h"
#include "debug.h"
/*****************************宏定义(私有)************************************
*
*备注: 本文件中,不希望被外部使用或随意修改的宏在这里定义
*
*****************************************************************************/

/**************************数据类型及结构定义(私有)***************************
*
*备注: 本文件中,不希望被外部使用的数据结构及类型在这里定义
*
*****************************************************************************/

/*****************************函数声明(私有)**********************************
*
*备注: 本文件中,不希望被外部调用的函数统一在这里声明
*
*****************************************************************************/

/********************************变量定义*************************************
*
*备注: 不要在.h中定义变量,防止多个.c包含这个.h,导致编译后报错变量重复定义
*
*****************************************************************************/
BTN_DRIVER_t    hBtnDriver[BTN_DRV_NB];
BTN_DRV_MASK_t  g_BtnDrvExistFlag = 0;      //用来标志已创建实例的按钮驱动句柄
/********************************函数定义************************************
*函数名:

*函数功能描述: 按钮设备驱动-常规IO按钮驱动器

*函数参数: 无

*函数返回值: 无

*备注:
*****************************************************************************/
/*创建按钮驱动器*/
int8_t btn_drv_IOGen_Create(uint8_t Index, BTN_IO_t *IOInput, uint8_t IOInputNb)
{
    /*参数诊断*/
    DEBUG_ASSERT(!IOInput || !IOInputNb || IOInputNb > BTN_IO_LI_NB_MAX);   //如果IOInputNb==0,则malloc(0)也能成功分配内存!但会影响程序后续释放内存操作
    DEBUG_ASSERT(Index >= BTN_DRV_NB);

    /*分配内存+初始化*/
    BTN_IO_GEN_t *pGen = (BTN_IO_GEN_t*)malloc(sizeof(BTN_IO_GEN_t));
    if(!pGen)   //注: malloc()失败返回值为0
        return RES_ERR_NEW_OBJ;
    memset(pGen, 0, sizeof(BTN_IO_GEN_t));
    hBtnDriver[Index].BtnDriverGen = pGen;   //绑定
    g_BtnDrvExistFlag |= (1<<Index);
    /*端口初始化*/
    return btn_drv_IOGen_Set_IO(pGen, IOInput, IOInputNb);
}
/*删除按钮驱动器*/
int8_t btn_drv_IOGen_Delete(uint8_t Index)
{
    /*参数诊断*/
    DEBUG_ASSERT(!(g_BtnDrvExistFlag & (1<<Index)));

    /*释放内存*/
    BTN_IO_GEN_t *pGen = hBtnDriver[Index].BtnDriverGen;
    if(pGen->IOInput)
        free(pGen->IOInput);
    if(pGen != 0)
        free(pGen);
    hBtnDriver[Index].BtnDriverGen = 0;   //解绑定
    g_BtnDrvExistFlag &= (~(1<<Index));
    return RES_SUCCESS;
}
/*设置按钮驱动器信号端口*/
int8_t btn_drv_IOGen_Set_IO(BTN_IO_GEN_t* pGen, BTN_IO_t *IOInput, uint8_t IOInputNb)
{
    /*参数诊断*/
    DEBUG_ASSERT(!pGen || !IOInput);
    DEBUG_ASSERT(!IOInputNb || IOInputNb > BTN_IO_LI_NB_MAX);   //如果IOInputNb==0,则malloc(0)也能成功分配内存!但会影响程序后续释放内存操作

    /*释放原先端口对应内存(防止内存泄露)*/
    if(pGen->IOInput != 0)
    {
        pGen->IOInputNb = 0;
        free(pGen->IOInput);
    }
    /*分配内存,并按新端口参数初始化*/
    pGen->IOInput = malloc(sizeof(BTN_IO_t) * IOInputNb);
    if(!pGen->IOInput)
    {
        return RES_ERR_NEW_OBJ;
    }
    pGen->IOInputNb = IOInputNb;
    for(uint8_t i = 0; i < IOInputNb; i++)
    {
        pGen->IOInput[i] = IOInput[i];
    }
    return RES_SUCCESS;
}
/*按钮驱动器句柄索引*/
BTN_IO_GEN_t* btn_drv_IOGen_Get_Handle(uint8_t Index)
{
    /*参数检查*/
    if (!(g_BtnDrvExistFlag & (1<<Index)))
        return 0;
    return hBtnDriver[Index].BtnDriverGen;
}
/*更新按钮驱动器信号端口值(1ms调用1次)*/
int8_t btn_drv_IOGen_Update_Value(uint8_t Index)
{
    /*参数检查*/
    if (!(g_BtnDrvExistFlag & (1<<Index)))
        return RES_ERR_PARAM;
    BTN_IO_GEN_t *pGen = hBtnDriver[Index].BtnDriverGen;
    uint8_t State = 0;

    /*读取键值*/
    for(uint8_t i = 0; i < pGen->IOInputNb; i++)
    {
    #if (IO_BTNVALUE_OUTPUT_SEQ == 0)
        State |= (BTN_READ_LI(pGen->IOInput[i].BtnPort, pGen->IOInput[i].BtnPin) << i);
    #else
        State |= (BTN_READ_LI(pGen->IOInput[i].BtnPort, pGen->IOInput[i].BtnPin) << (pGen->IOInputNb - (i+1) ));
    #endif
    }
    //按键消抖
    if(pGen->IOInputValuePrev == State)
    {
        if(++pGen->DebounceCnt >= BTN_IO_DEBOUNCE)
        {
            pGen->DebounceCnt = BTN_IO_DEBOUNCE;
            pGen->IOInputValue = State;
            return RES_SUCCESS;
        }
    }else
    {
        pGen->DebounceCnt = 0;
    }
    pGen->IOInputValuePrev = State;

    return RES_BUSY;
}
/*获取按钮驱动器信号端口值*/
BTN_VALUE_t btn_drv_IOGen_Get_Value(BTN_DRIVER_t Driver)
{
    return Driver.BtnDriverGen->IOInputValue;
}
/********************************函数定义************************************
*函数名:

*函数功能描述: 按钮设备驱动-矩阵IO按钮驱动器

*函数参数: 无

*函数返回值: 无

*备注:
*****************************************************************************/
/*创建按钮驱动器*/
int8_t btn_drv_IOMat_Create(uint8_t Index, BTN_IO_t *IOInputOutput, uint8_t IOInputNb, uint8_t IOOutputNb)
{
    /*参数诊断*/
    DEBUG_ASSERT(!IOInputOutput || !IOInputNb || IOInputNb > BTN_IO_LI_NB_MAX || !IOOutputNb);   //如果IOInputNb==0,则malloc(0)也能成功分配内存!但会影响程序后续释放内存操作
    DEBUG_ASSERT(Index >= BTN_DRV_NB);

    /*分配内存+初始化*/
    BTN_IO_MT_t *pMat = (BTN_IO_MT_t*)malloc(sizeof(BTN_IO_MT_t));
    if(!pMat)   //注: malloc()失败返回值为0
        return RES_ERR_NEW_OBJ;
    memset(pMat, 0, sizeof(BTN_IO_MT_t));
    hBtnDriver[Index].BtnDriverMT = pMat;   //绑定
    g_BtnDrvExistFlag |= (1<<Index);
    /*端口初始化*/
    return btn_drv_IOMat_Set_IO(pMat, IOInputOutput, IOInputNb, IOOutputNb);
}
/*删除按钮驱动器*/
int8_t btn_drv_IOMat_Delete(uint8_t Index)
{
    /*参数诊断*/
    DEBUG_ASSERT(!(g_BtnDrvExistFlag & (1<<Index)));

    /*释放内存*/
    BTN_IO_MT_t *pMat = hBtnDriver[Index].BtnDriverMT;
    if(pMat->IOInput)
        free(pMat->IOInput);
    if(pMat->IOOutput)
        free(pMat->IOOutput);
    if(pMat != 0)
        free(pMat);
    hBtnDriver[Index].BtnDriverMT = 0;   //解绑定
    g_BtnDrvExistFlag &= (~(1<<Index));
    return RES_SUCCESS;
}
/*设置按钮驱动器信号端口*/
int8_t btn_drv_IOMat_Set_IO(BTN_IO_MT_t* pMat, BTN_IO_t *IOInputOutput, uint8_t IOInputNb, uint8_t IOOutputNb)
{
    /*参数诊断*/
    DEBUG_ASSERT(!pMat || !IOInputOutput);
    DEBUG_ASSERT(!IOInputNb || IOInputNb > BTN_IO_LI_NB_MAX || !IOOutputNb);   //如果IOInputNb==0,则malloc(0)也能成功分配内存!但会影响程序后续释放内存操作

    /*释放原先端口对应内存(防止内存泄露)*/
    if(pMat->IOInput != 0)
    {
        pMat->IOInputNb = 0;
        free(pMat->IOInput);
    }
    if(pMat->IOOutput != 0)
    {
        pMat->IOOutputNb = 0;
        free(pMat->IOOutput);
    }
    /*分配内存,并按新端口参数初始化*/
    pMat->IOInput = malloc(sizeof(BTN_IO_t) * IOInputNb);
    if(!pMat->IOInput)
    {
        return RES_ERR_NEW_OBJ;
    }
    pMat->IOOutput = malloc(sizeof(BTN_IO_t) * IOOutputNb);
    if(!pMat->IOOutput)
    {
        free(pMat->IOInput);     //子成员分配内存失败则释放已分配内存(避免内存泄露)
        return RES_ERR_NEW_OBJ;
    }
    pMat->IOInputNb = IOInputNb;
    pMat->IOOutputNb = IOOutputNb;
    uint8_t j = 0;
    for(uint8_t i = 0; i < (IOInputNb + IOOutputNb) ; i++)
    {
        if(i<IOInputNb)
            pMat->IOInput[i] = IOInputOutput[i];
        else
            pMat->IOOutput[j++] = IOInputOutput[i];
    }
    return RES_SUCCESS;
}
/*按钮驱动器句柄索引*/
BTN_IO_MT_t* btn_drv_IOMat_Get_Handle(uint8_t Index)
{
    /*参数检查*/
    if (!(g_BtnDrvExistFlag & (1<<Index)))
        return 0;
    return hBtnDriver[Index].BtnDriverMT;
}
/*更新按钮驱动器信号端口值(1ms调用1次)*/
int8_t btn_drv_IOMat_Update_Value(uint8_t Index)
{
    /*参数检查*/
    if (!(g_BtnDrvExistFlag & (1<<Index)))
        return RES_ERR_PARAM;
    BTN_IO_MT_t *pMat = hBtnDriver[Index].BtnDriverMT;
    BTN_VALUE_t   MatrixValue = 0;
    uint8_t IOLevel = 0;

    /*矩阵信号扫描读取*/
    for(uint8_t i = 0; i < pMat->IOOutputNb; i++)
    {
        BTN_SET_LO(pMat->IOOutput[i].BtnPort, pMat->IOOutput[i].BtnPin);
        __nop();    //wait for output line is driven high
        for(uint8_t j = 0; j < pMat->IOInputNb; i++)
        {
            IOLevel = BTN_READ_LI(pMat->IOInput[j].BtnPort, pMat->IOInput[j].BtnPin);
            MatrixValue |= IOLevel << (i * pMat->IOInputNb + j);
        }
        BTN_CLR_LO(pMat->IOOutput[i].BtnPort, pMat->IOOutput[i].BtnPin);
        __nop();    //wait for output line is driven low
    }

    /*矩阵信号消抖*/
    if(MatrixValue == pMat->IOInputValuePrev)
    {
        if(pMat->DebounceCnt++ >= BTN_IO_DEBOUNCE)
        {
            pMat->DebounceCnt = BTN_IO_DEBOUNCE;
            if(pMat->IOInputValue != MatrixValue)
                pMat->IOInputValue = MatrixValue;
        }
    }else
        pMat->DebounceCnt = 0;
    pMat->IOInputValuePrev = MatrixValue;
    return RES_SUCCESS;
}
/*获取按钮驱动器信号端口值*/
BTN_VALUE_t btn_drv_IOMat_Get_Value(BTN_DRIVER_t Driver)
{
    return Driver.BtnDriverMT->IOInputValue;
}
